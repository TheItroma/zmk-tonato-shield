## boards/shields/tonato/Kconfig.defconfig
```kconfig
if SHIELD_TONATO_LEFT

# Name must be less than 16 characters long!
config ZMK_KEYBOARD_NAME
    default "Tonato"

config ZMK_SPLIT_ROLE_CENTRAL
    default y

endif

if SHIELD_TONATO_LEFT || SHIELD_TONATO_RIGHT

config ZMK_SPLIT
    default y

endif
```

## boards/shields/tonato/Kconfig.shield
```kconfig
config SHIELD_MY_KEYBOARD_LEFT
    def_bool $(shields_list_contains,tonato_left)
config SHIELD_MY_KEYBOARD_RIGHT
    def_bool $(shields_list_contains,tonato_right)
```

## config/west.yml
```yaml
manifest:
  remotes:
    - name: zmkfirmware
      url-base: https://github.com/zmkfirmware
    - name: theitroma
      url-base: https://github.com/TheItroma
  projects:
    - name: zmk
      remote: zmkfirmware
      revision: main
      import: app/west.yml
    - name: tonato_module
      remote: theitroma
      revision: main
  self:
    path: config
```
